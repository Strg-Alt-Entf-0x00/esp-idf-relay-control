## examples/console_relay/sdkconfig.defaults
```kconfig
# ============================================================================
# ESP32-P4 Hardware Target Configuration
# ============================================================================
CONFIG_IDF_TARGET="esp32p4"
CONFIG_ESP32P4_SELECTS_REV_LESS_V3=y

# ============================================================================
# Flash Configuration (32 MB QIO Mode)
# ============================================================================
CONFIG_ESPTOOLPY_FLASHMODE_QIO=y
CONFIG_ESPTOOLPY_FLASHSIZE_32MB=y
```
